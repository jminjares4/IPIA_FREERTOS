/**
 * @cliArgs --board "/ti/boards/MSP_EXP432P401R" --product "simplelink_msp432p4_sdk@3.40.01.02"
 * @versions {"data":"2020021217","timestamp":"2020021217","tool":"1.4.0+1234","templates":"2020021217"}
 */

/**
 * Import the modules used in this configuration.
 */
const Display  = scripting.addModule("/ti/display/Display", {}, false);
const Display1 = Display.addInstance();
const ADC      = scripting.addModule("/ti/drivers/ADC", {}, false);
const ADC1     = ADC.addInstance();
const ADC2     = ADC.addInstance();
const GPIO     = scripting.addModule("/ti/drivers/GPIO");
const GPIO1    = GPIO.addInstance();
const GPIO2    = GPIO.addInstance();
const PWM      = scripting.addModule("/ti/drivers/PWM", {}, false);
const PWM1     = PWM.addInstance();
const PWM2     = PWM.addInstance();
const RTOS     = scripting.addModule("/ti/drivers/RTOS");
const Timer    = scripting.addModule("/ti/drivers/Timer", {}, false);
const Timer1   = Timer.addInstance();
const Timer2   = Timer.addInstance();
const UART     = scripting.addModule("/ti/drivers/UART", {}, false);
const UART1    = UART.addInstance();
const UART2    = UART.addInstance();

/**
 * Write custom configuration values to the imported modules.
 */
Display1.$name           = "CONFIG_Display_0";
Display1.$hardware       = system.deviceData.board.components.XDS110UART;
Display1.uart.$name      = "CONFIG_UART_0";
Display1.uart.uart.$name = "MyUART1";

ADC1.$name              = "SOLAR_PANEL";
ADC1.adc.$name          = "MyADC141";
ADC1.adc.$assign        = "ADC14";
ADC1.adc.adcPin.$assign = "boosterpack.30";

ADC2.$name              = "PRESSURE_SENSOR";
ADC2.adc.$name          = "MyADC141";
ADC2.adc.$assign        = "ADC14";
ADC2.adc.adcPin.$assign = "boosterpack.29";

GPIO1.$name           = "SIM33EAU_EN";
GPIO1.mode            = "Output";
GPIO1.gpioPin.$assign = "boosterpack.11";

GPIO2.$name           = "RED";
GPIO2.$hardware       = system.deviceData.board.components.LED1_RED;
GPIO2.gpioPin.$assign = "P1.0.GPIO/EUSCI_A0_SPI.STE";

PWM1.$name                = "Y_AXIS";
PWM1.timer.$name          = "MyTIMER_A1";
PWM1.timer.$assign        = "Timer_A1";
PWM1.timer.pwmPin.$assign = "boosterpack.40";

PWM2.$name                = "X_AXIS";
PWM2.timer.$name          = "MyTIMER_A1";
PWM2.timer.$assign        = "Timer_A1";
PWM2.timer.pwmPin.$assign = "boosterpack.39";

const Power                   = scripting.addModule("/ti/drivers/Power", {}, false);
Power.performanceLevel3.$name = "ti_drivers_power_PowerMSP432PerfLevels0";
Power.performanceLevel2.$name = "ti_drivers_power_PowerMSP432PerfLevels1";
Power.performanceLevel1.$name = "ti_drivers_power_PowerMSP432PerfLevels2";
Power.performanceLevel0.$name = "ti_drivers_power_PowerMSP432PerfLevels3";

RTOS.name = "FreeRTOS";

Timer1.$name             = "TIMERA0";
Timer1.interruptPriority = "6";
Timer1.timer.$name       = "MyTIMER_A1";
Timer1.timer.$assign     = "Timer_A0";

Timer2.$name         = "PRESSURE_SENSOR_TIMER";
Timer2.timer.$name   = "MyTIMER_A1";
Timer2.timer.$assign = "Timer_A2";

UART1.$name              = "BLUETOOTH";
UART1.baudRates          = [9600];
UART1.ringBufferSize     = 64;
UART1.uart.$name         = "MyUART1";
UART1.uart.txPin.$assign = "boosterpack.4";
UART1.uart.rxPin.$assign = "boosterpack.3";

UART2.$name              = "SIM33EAU_GPS";
UART2.dataDirection      = "Receive Only";
UART2.baudRates          = [9600];
UART2.ringBufferSize     = 128;
UART2.uart.$name         = "MyUART1";
UART2.uart.rxPin.$assign = "boosterpack.18";

/**
 * Pinmux solution for unlocked pins/peripherals. This ensures that minor changes to the automatic solver in a future
 * version of the tool will not impact the pinmux you originally saw.  These lines can be completely deleted in order to
 * re-solve from scratch.
 */
Display1.uart.uart.$suggestSolution       = "EUSCI_A0";
Display1.uart.uart.txPin.$suggestSolution = "7";
Display1.uart.uart.rxPin.$suggestSolution = "6";
UART1.uart.$suggestSolution               = "EUSCI_A2";
UART2.uart.$suggestSolution               = "EUSCI_A1";
